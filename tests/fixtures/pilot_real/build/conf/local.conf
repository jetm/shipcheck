## tests/fixtures/pilot_real/build/conf/local.conf
```bitbake
# shipcheck-pilot
# Enable the two Yocto classes whose output shipcheck audits:
# create-spdx produces tmp/deploy/spdx/*.spdx.json documents and
# cve-check produces per-recipe CVE reports plus the aggregate
# summary at tmp/log/cve/cve-summary.json.
INHERIT += "create-spdx cve-check"

# cve-check defaults. The cve-check.bbclass task
# do_cve_check_write_rootfs_manifest creates a symlink at
# ${LOG_DIR}/cve/cve-summary.json pointing at the latest per-image
# aggregate manifest, and shipcheck's yocto-cve-check reads that
# symlink directly - so no path override is needed here.
#
# Do NOT override CVE_CHECK_LOG_JSON, CVE_CHECK_SUMMARY_DIR, or
# CVE_CHECK_SUMMARY_FILE_NAME_JSON. CVE_CHECK_LOG_JSON defaults to
# ${T}/cve.json (the per-recipe temp dir, always exists); pointing
# it at the aggregate summary path causes the first recipe's
# do_cve_check to FileNotFoundError because the aggregate dir is
# only created later by the per-image manifest task. See
# docs/pilot.md Troubleshooting for the full story.
CVE_CHECK_DB_UPDATE = "1"
CVE_CHECK_FORMAT_JSON = "1"

# Keep the build deterministic-ish for the pilot: one thread per
# CPU core, standard sstate reuse. Anyone re-running the pilot
# can override via environment variables.
BB_NUMBER_THREADS ?= "${@oe.utils.cpu_count()}"
PARALLEL_MAKE    ?= "-j ${@oe.utils.cpu_count()}"

# create-spdx options. Default SPDX_INCLUDE_SOURCES is off; we
# leave it off because pilot 0001 only audits the metadata
# layer, not the source archive layer. Flip to "1" in later
# pilots if license-audit needs source-file granularity.
SPDX_INCLUDE_SOURCES = "0"

# Make the SBOM and CVE outputs reproducible enough to diff
# across re-runs of the same pilot.
BB_HASHCONFIG_IGNORE_VARS += "DATE TIME"

MACHINE ??= "qemux86-64"
DISTRO ??= "poky"
BBMULTICONFIG ?= ""
```

## tests/fixtures/secureboot/auto-conf/conf/local.conf
```bitbake
# Minimal local.conf - signing configured in auto.conf
MACHINE = "genericx86-64"
DISTRO = "poky"
```

## tests/fixtures/secureboot/efi-no-signing/conf/local.conf
```bitbake
# Yocto build configuration with EFI artifacts but no signing
MACHINE = "genericx86-64"
DISTRO = "poky"
IMAGE_CLASSES += "image-mklibs"
EFI_PROVIDER = "systemd-boot"
```

## tests/fixtures/secureboot/missing-keys/conf/local.conf
```bitbake
# Signing configured but key files do not exist
MACHINE = "genericx86-64"
DISTRO = "poky"
IMAGE_CLASSES += "uefi-sign"
SECURE_BOOT_SIGNING_KEY = "${TOPDIR}/keys/nonexistent.key"
SECURE_BOOT_DB_KEY = "${TOPDIR}/keys/nonexistent-db.key"
```

## tests/fixtures/secureboot/no-signing/conf/local.conf
```bitbake
# Yocto build configuration without Secure Boot signing
MACHINE = "genericx86-64"
DISTRO = "poky"
IMAGE_CLASSES += "image-mklibs image-prelink"
```

## tests/fixtures/secureboot/sbsign-class/conf/local.conf
```bitbake
# Yocto build configuration using sbsign class
MACHINE = "genericx86-64"
DISTRO = "poky"
IMAGE_CLASSES += "sbsign"
SECURE_BOOT_SIGNING_KEY = "${TOPDIR}/keys/prod-key.pem"
```

## tests/fixtures/secureboot/signing-enabled/conf/local.conf
```bitbake
# Yocto build configuration with Secure Boot signing enabled
MACHINE = "genericx86-64"
DISTRO = "poky"
IMAGE_CLASSES += "uefi-sign"
SECURE_BOOT_SIGNING_KEY = "${TOPDIR}/keys/db.key"
SECURE_BOOT_SIGNING_CERT = "${TOPDIR}/keys/db.crt"
```

## tests/fixtures/secureboot/test-keys/conf/local.conf
```bitbake
# Yocto build configuration with signing but using test keys
MACHINE = "genericx86-64"
DISTRO = "poky"
IMAGE_CLASSES += "uefi-sign"
SECURE_BOOT_SIGNING_KEY = "${TOPDIR}/keys/test-signing-key.pem"
SECURE_BOOT_DB_KEY = "${TOPDIR}/keys/development-db.key"
```
